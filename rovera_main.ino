/*
 * Robot Mecanum PRO + OLED System (Updated)
 * Fitur: 
 * 1. Pergerakan Mecanum dengan Rear Bias 1.15
 * 2. Speed Level & Dual Mode Capit
 * 3. OLED Multi-Logo (Untir, URC, Tirtapod) ganti tiap 15 detik
 * 4. R3 Toggle: Switch Speed Rotasi Joystick (120 <-> 100)
 * 5. Circle Button: Instant Left Rotate (Speed 200)
 */

#include <Ps3Controller.h>
#include <Wire.h>
#include <Adafruit_GFX.h>
#include <Adafruit_SH110X.h>

// ================= OLED SETTINGS =================
#define SCREEN_WIDTH 128
#define SCREEN_HEIGHT 64
#define OLED_RESET -1
#define I2C_ADDR 0x3C
Adafruit_SH1106G display(SCREEN_WIDTH, SCREEN_HEIGHT, &Wire, OLED_RESET);

// ================= BITMAP =================
#define LOGO_Untir_W 64
#define LOGO_Untir_H 64
extern const unsigned char logo_untir_bmp[] PROGMEM = {
  0x00, 0x00, 0x00, 0x00, 0x00, 0x00, 0x00, 0x00, 0x00, 0x00, 0x00, 0x01, 0x80, 0x00, 0x00, 0x00, 
	0x00, 0x00, 0x00, 0x0f, 0xf0, 0x00, 0x00, 0x00, 0x00, 0x00, 0x00, 0x3e, 0x7c, 0x00, 0x00, 0x00, 
	0x00, 0x00, 0x00, 0xf3, 0xcf, 0x00, 0x00, 0x00, 0x00, 0x00, 0x03, 0xde, 0x7b, 0xe0, 0x00, 0x00, 
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	0x00, 0x00, 0x00, 0x07, 0xe0, 0x00, 0x00, 0x00, 0x00, 0x00, 0x00, 0x00, 0x00, 0x00, 0x00, 0x00
};

// --- LOGO URC ---
#define LOGO_URC_W 128
#define LOGO_URC_H 64
extern const unsigned char logo_urc_bmp[] PROGMEM = {
  0x00, 0x00, 0x00, 0x00, 0x00, 0x00, 0x00, 0x00, 0x00, 0x00, 0x00, 0x00, 0x00, 0x00, 0x00, 0x00, 
	0x00, 0x00, 0x00, 0x00, 0x00, 0x00, 0x00, 0x00, 0x00, 0x00, 0x00, 0x00, 0x00, 0x00, 0x00, 0x00, 
	0x00, 0x00, 0x00, 0x00, 0x00, 0x00, 0x00, 0x00, 0x00, 0x00, 0x00, 0x00, 0x00, 0x00, 0x00, 0x00, 
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	0x00, 0x00, 0x00, 0x00, 0x00, 0x00, 0x00, 0x00, 0x00, 0x00, 0x00, 0x00, 0x00, 0x00, 0x00, 0x00
};

#define LOGO_TIRTAPOD_W 128
#define LOGO_TIRTAPOD_H 64
extern const unsigned char logo_tirtapod_bmp[] PROGMEM ={
  0x00, 0x00, 0x00, 0x00, 0x00, 0x00, 0x00, 0x00, 0x00, 0x00, 0x00, 0x00, 0x00, 0x00, 0x00, 0x00, 
	0x00, 0x00, 0x00, 0x00, 0x00, 0x00, 0x00, 0x00, 0x00, 0x00, 0x00, 0x00, 0x00, 0x00, 0x00, 0x00, 
	0x00, 0x00, 0x00, 0x00, 0x00, 0x00, 0x00, 0x00, 0x00, 0x00, 0x00, 0x00, 0x00, 0x00, 0x00, 0x00, 
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	0x00, 0x00, 0x00, 0x00, 0x00, 0x00, 0x00, 0x00, 0x00, 0x00, 0x00, 0x00, 0x00, 0x00, 0x00, 0x00
};


// ================= PIN DEFINITIONS =================
#define FR_RPWM 12
#define FR_LPWM 14
#define FL_RPWM 27
#define FL_LPWM 26
#define RR_RPWM 25
#define RR_LPWM 33
#define RL_RPWM 32
#define RL_LPWM 13

#define PWMA 15
#define AIN1 4
#define AIN2 5
#define STBY 2

#define SERVO_CAPIT_PIN 23
#define SERVO_ROTASI_PIN 17

// ================= PWM CHANNEL =================
#define CH_FR_R 0
#define CH_FR_L 1
#define CH_FL_R 2
#define CH_FL_L 3
#define CH_RR_R 4
#define CH_RR_L 5
#define CH_RL_R 6
#define CH_RL_L 7
#define CH_LIFTER 14  
#define CH_CAPIT 9
#define CH_ROTASI 10

// ================= PARAMETERS & GLOBALS =================
#define DEADZONE 15
#define ACC_STEP 5
#define BRAKE_PWM 255
#define TRIGGER_THRESHOLD 20 
#define MAX_LIFTER_PWM 255   

// Speed Variables
int currentMaxSpeed = 150; 
int currentRotateLimit = 120; // Default limit rotasi joystick
#define SPEED_LV1 150
#define SPEED_LV2 220
#define SPEED_STRAFE 200     
#define MAX_PWM_COMBINED 200  
#define CIRCLE_ROTATE_SPEED 200 // Speed khusus tombol Circle

float rearBias = 1.15; 

// Button States
bool capitState = false, rotasiState = false, rotasiState2 = false;
bool r1Pressed = false, l1Pressed = false, crossPressed = false;
bool upPressed = false, downPressed = false, rightPressed = false;
bool r3Pressed = false; 
bool stopCommand = true;

int vxT = 0, vyT = 0, wT = 0; 
int vxC = 0, vyC = 0, wC = 0; 

// Timing OLED
const unsigned long oledInterval = 15000; 
unsigned long lastOledSwitch = 0;
uint8_t currentLogo = 0;

// ================= OLED FUNCTIONS =================
void glitchTransition() {
  for (int i = 0; i < 5; i++) {
    display.clearDisplay();
    for (int j = 0; j < random(2, 5); j++) {
      int y = random(0, SCREEN_HEIGHT);
      display.fillRect(0, y, SCREEN_WIDTH, random(2, 4), SH110X_WHITE);
    }
    display.display();
    delay(20);
  }
}

void showTitle() {
  display.clearDisplay();
  display.setTextColor(SH110X_WHITE);
  display.setTextSize(2); display.setCursor(20, 4); display.print("POLINES");
  display.setTextSize(1); display.setCursor(18, 28); display.print("ROBOTIC CONTEST");
  display.setTextSize(2); display.setCursor(38, 42); display.print("2026");
  display.display();
  delay(2000);
}

void updateOLED() {
  display.clearDisplay();
  switch (currentLogo) {
    case 0: display.drawBitmap((SCREEN_WIDTH - 64)/2, 0, logo_untir_bmp, 64, 64, SH110X_WHITE); break;
    case 1: display.drawBitmap(0, 0, logo_urc_bmp, 128, 64, SH110X_WHITE); break;
    case 2: display.drawBitmap(0, 0, logo_tirtapod_bmp, 128, 64, SH110X_WHITE); break;
  }
  display.display();
}

// ================= MOTOR & UTILITY =================
int angleToDuty(int angle) { return map(angle, 0, 180, 205, 1024); }

void setMotor(uint8_t chR, uint8_t chL, int sp, bool inv) {
  if (inv) sp = -sp;
  if (stopCommand) { ledcWrite(chR, BRAKE_PWM); ledcWrite(chL, BRAKE_PWM); return; }
  if (sp > 0) { ledcWrite(chR, sp); ledcWrite(chL, 0); }
  else if (sp < 0) { ledcWrite(chR, 0); ledcWrite(chL, -sp); }
  else { ledcWrite(chR, 0); ledcWrite(chL, 0); }
}

void setMecanum(int vx, int vy, int w) {
  int fr = vy - vx - w; int fl = vy + vx + w;
  int rr = vy + vx - w; int rl = vy - vx + w;
  int maxS = max(max(abs(fr), abs(fl)), max(abs(rr), abs(rl)));
  
  if (maxS > 0) {
    int limit;
    // 1. Cek Tombol Circle (Prioritas Speed 200)
    if (Ps3.data.button.circle) {
      limit = CIRCLE_ROTATE_SPEED;
    }
    // 2. Cek Gerakan Kombinasi (Jalan + Putar)
    else if ((vx != 0 || vy != 0) && w != 0) {
      limit = MAX_PWM_COMBINED;
    }
    // 3. Cek Murni Rotasi Joystick (Pakai limit dinamis R3)
    else if (abs(w) > abs(vx) && abs(w) > abs(vy)) {
      limit = currentRotateLimit;
    }
    // 4. Strafe (Kanan/Kiri)
    else if (abs(vx) > abs(vy)) {
      limit = SPEED_STRAFE;
    }
    // 5. Jalan Lurus (Maju/Mundur)
    else {
      limit = currentMaxSpeed;
    }
    
    float s = (float)limit / maxS;
    fr *= s; fl *= s; rr *= s; rl *= s;
  }

  int finalRR = constrain((int)(rr * rearBias), -255, 255);
  int finalRL = constrain((int)(rl * rearBias), -255, 255);
  setMotor(CH_FR_R, CH_FR_L, (int)fr, true);
  setMotor(CH_FL_R, CH_FL_L, (int)fl, false);
  setMotor(CH_RR_R, CH_RR_L, finalRR, true);
  setMotor(CH_RL_R, CH_RL_L, finalRL, false);
}

void ramp(int &cur, int tgt) {
  if (cur < tgt) { cur += ACC_STEP; if (cur > tgt) cur = tgt; }
  else if (cur > tgt) { cur -= ACC_STEP; if (cur < tgt) cur = tgt; }
}

// ================= SETUP =================
void setup() {
  Serial.begin(115200);
  
  for (int i = 0; i <= 7; i++) ledcSetup(i, 5000, 8);
  ledcAttachPin(FR_RPWM, CH_FR_R); ledcAttachPin(FR_LPWM, CH_FR_L);
  ledcAttachPin(FL_RPWM, CH_FL_R); ledcAttachPin(FL_LPWM, CH_FL_L);
  ledcAttachPin(RR_RPWM, CH_RR_R); ledcAttachPin(RR_LPWM, CH_RR_L);
  ledcAttachPin(RL_RPWM, CH_RL_R); ledcAttachPin(RL_LPWM, CH_RL_L);

  ledcSetup(CH_LIFTER, 500, 8); ledcAttachPin(PWMA, CH_LIFTER);
  pinMode(AIN1, OUTPUT); pinMode(AIN2, OUTPUT); pinMode(STBY, OUTPUT);
  digitalWrite(STBY, HIGH);

  ledcSetup(CH_CAPIT, 50, 13); ledcSetup(CH_ROTASI, 50, 13);
  ledcAttachPin(SERVO_CAPIT_PIN, CH_CAPIT); ledcAttachPin(SERVO_ROTASI_PIN, CH_ROTASI);
  ledcWrite(CH_CAPIT, angleToDuty(0)); ledcWrite(CH_ROTASI, angleToDuty(106));

  Ps3.begin("84:1f:e8:1b:5f:ae");

  display.begin(I2C_ADDR, true);
  randomSeed(analogRead(0));
  glitchTransition();
  showTitle();
  updateOLED();
}

// ================= LOOP =================
void loop() {
  if (millis() - lastOledSwitch >= oledInterval) {
    lastOledSwitch = millis();
    currentLogo = (currentLogo + 1) % 3;
    updateOLED(); 
  }

  if (Ps3.isConnected()) {
    // 1. Toggle Speed Rotate (R3)
    if (Ps3.data.button.r3 && !r3Pressed) {
      currentRotateLimit = (currentRotateLimit == 120) ? 100 : 120;
      r3Pressed = true;
    } else if (!Ps3.data.button.r3) r3Pressed = false;

    // 2. Speed Level (Up/Down)
    if (Ps3.data.button.up && !upPressed) { currentMaxSpeed = SPEED_LV2; upPressed = true; }
    else if (!Ps3.data.button.up) upPressed = false;
    if (Ps3.data.button.down && !downPressed) { currentMaxSpeed = SPEED_LV1; downPressed = true; }
    else if (!Ps3.data.button.down) downPressed = false;

    // 3. Movement
    int lx = Ps3.data.analog.stick.lx;
    int ly = -Ps3.data.analog.stick.ly;
    int rx = Ps3.data.analog.stick.rx;
    
    vxT = abs(lx) > DEADZONE ? map(lx, -128, 127, -100, 100) : 0;
    vyT = abs(ly) > DEADZONE ? map(ly, -128, 127, -100, 100) : 0;

    // Tombol Circle Override Rotasi
    if (Ps3.data.button.circle) {
      wT = -100; // Rotasi Kiri
      stopCommand = false;
    } else {
      wT = abs(rx) > DEADZONE ? map(rx, -128, 127, -100, 100) : 0;
      stopCommand = !(abs(lx) > DEADZONE || abs(ly) > DEADZONE || abs(rx) > DEADZONE);
    }

    // 4. Lifter & Servos
    int r2 = Ps3.data.analog.button.r2; int l2 = Ps3.data.analog.button.l2;
    if (r2 > TRIGGER_THRESHOLD) { digitalWrite(AIN1, HIGH); digitalWrite(AIN2, LOW); ledcWrite(CH_LIFTER, map(r2, 0, 255, 0, MAX_LIFTER_PWM)); }
    else if (l2 > TRIGGER_THRESHOLD) { digitalWrite(AIN1, LOW); digitalWrite(AIN2, HIGH); ledcWrite(CH_LIFTER, map(l2, 0, 255, 0, MAX_LIFTER_PWM)); }
    else { digitalWrite(AIN1, LOW); digitalWrite(AIN2, LOW); ledcWrite(CH_LIFTER, 0); }

    if (Ps3.data.button.r1 && !r1Pressed) { capitState = !capitState; ledcWrite(CH_CAPIT, angleToDuty(capitState ? 180 : 0)); r1Pressed = true; }
    else if (!Ps3.data.button.r1) r1Pressed = false;
    if (Ps3.data.button.cross && !crossPressed) { capitState = !capitState; ledcWrite(CH_CAPIT, angleToDuty(capitState ? 90 : 0)); crossPressed = true; }
    else if (!Ps3.data.button.cross) crossPressed = false;
    if (Ps3.data.button.l1 && !l1Pressed) { rotasiState = !rotasiState; ledcWrite(CH_ROTASI, angleToDuty(rotasiState ? 16 : 106)); l1Pressed = true; }
    else if (!Ps3.data.button.l1) l1Pressed = false;
    if (Ps3.data.button.right && !rightPressed) { rotasiState2 = !rotasiState2; ledcWrite(CH_ROTASI, angleToDuty(rotasiState2 ? 196 : 106)); rightPressed = true; }
    else if (!Ps3.data.button.right) rightPressed = false;

  } else {
    vxT = vyT = wT = 0; stopCommand = true; ledcWrite(CH_LIFTER, 0);
  }

  ramp(vxC, vxT); ramp(vyC, vyT); ramp(wC, wT);
  setMecanum(vxC, vyC, wC);
  delay(10);
}
